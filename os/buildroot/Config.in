## os/buildroot/configs/krdos_x86_64_defconfig
```kconfig
# KrdOS image (x86_64) using Buildroot.
# Boots to Weston and autostarts the Flutter shell.

BR2_x86_64=y
BR2_TOOLCHAIN_BUILDROOT_GLIBC=y

BR2_TARGET_GENERIC_HOSTNAME="krdos"
BR2_TARGET_GENERIC_ISSUE="KrdOS"
BR2_ROOTFS_OVERLAY="$(BR2_EXTERNAL_KRDOS_PATH)/../overlay"

# System
BR2_INIT_SYSTEMD=y
BR2_SYSTEM_DHCP="eth0"

# Filesystems / image
BR2_TARGET_ROOTFS_EXT2=y
BR2_TARGET_ROOTFS_EXT2_4=y
BR2_TARGET_ROOTFS_EXT2_SIZE="1024M"

# Kernel (Buildroot-managed, good for QEMU bringup)
BR2_LINUX_KERNEL=y
BR2_LINUX_KERNEL_USE_CUSTOM_CONFIG=y
BR2_LINUX_KERNEL_CUSTOM_CONFIG_FILE="$(BR2_EXTERNAL_KRDOS_PATH)/board/krdos/x86_64/linux.config"
BR2_LINUX_KERNEL_IMAGE=y

# Graphics: DRM/KMS + Mesa + Wayland/Weston + XWayland (needed for GTK/Flutter)
BR2_PACKAGE_MESA3D=y
BR2_PACKAGE_MESA3D_DRI_DRIVER=y
BR2_PACKAGE_MESA3D_GALLIUM_DRIVER=y
BR2_PACKAGE_WAYLAND=y
BR2_PACKAGE_WAYLAND_PROTOCOLS=y
BR2_PACKAGE_WESTON=y
BR2_PACKAGE_WESTON_XWAYLAND=y
BR2_PACKAGE_XORG7=y
BR2_PACKAGE_XSERVER_XORG_SERVER=y
BR2_PACKAGE_XAPP_XRANDR=y

# GTK3 — the Flutter Linux runner uses this
BR2_PACKAGE_LIBGTK3=y
BR2_PACKAGE_LIBGTK3_BROADWAY=n

# Input basics
BR2_PACKAGE_LIBINPUT=y
BR2_PACKAGE_XLIB_LIBXI=y

# Fonts — Flutter needs these to render text
BR2_PACKAGE_FONTCONFIG=y
BR2_PACKAGE_FONTS_DEJAVU=y

# Convenience for debugging (remove for production)
BR2_PACKAGE_BASH=y
BR2_PACKAGE_HTOP=y
```
